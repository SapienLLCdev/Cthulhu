/*
Cthulhu Shield Grideye examples for arduino mega
By: Joel Moritz Jr
Sapien LLC
1/30/19
*/




/*
  Visualizing the Panasonic Grid-EYE Sensor Data using Processing
  By: Nick Poole
  SparkFun Electronics
  Date: January 12th, 2018
  
  MIT License: Permission is hereby granted, free of charge, to any person obtaining a copy of this 
  software and associated documentation files (the "Software"), to deal in the Software without 
  restriction, including without limitation the rights to use, copy, modify, merge, publish, 
  distribute, sublicense, and/or sell copies of the Software, and to permit persons to whom the 
  Software is furnished to do so, subject to the following conditions:

  The above copyright notice and this permission notice shall be included in all copies or 
  substantial portions of the Software.

  THE SOFTWARE IS PROVIDED "AS IS", WITHOUT WARRANTY OF ANY KIND, EXPRESS OR IMPLIED, INCLUDING 
  BUT NOT LIMITED TO THE WARRANTIES OF MERCHANTABILITY, FITNESS FOR A PARTICULAR PURPOSE AND 
  NONINFRINGEMENT. IN NO EVENT SHALL THE AUTHORS OR COPYRIGHT HOLDERS BE LIABLE FOR ANY CLAIM, 
  DAMAGES OR OTHER LIABILITY, WHETHER IN AN ACTION OF CONTRACT, TORT OR OTHERWISE, ARISING FROM, 
  OUT OF OR IN CONNECTION WITH THE SOFTWARE OR THE USE OR OTHER DEALINGS IN THE SOFTWARE.
  
  Feel like supporting our work? Buy a board from SparkFun!
  https://www.sparkfun.com/products/14568
  
  This example is intended as a companion sketch to the Processing sketch found in the same folder.
  Once this code is running on your hardware, open the accompanying Processing sketch and run it 
  as well. The Processing sketch will receive the comma separated values generated by this code and
  use them to generate a thermal image. If you don't have Processing, you can download it here:
  https://processing.org/
  
  Hardware Connections:
  Attach the Qwiic Shield to your Arduino/Photon/ESP32 or other
  Plug the sensor onto the shield
*/
#include <Cthulhu.h>
#include <Wire.h>
#include <SparkFun_GridEYE_Arduino_Library.h>

GridEYE grideye;

// Use these values (in degrees C) to adjust the contrast
#define HOT 40
#define COLD 20

int pixelTable[64];
int mypixelTable[16];

int array[18];

//these are waveform parameter as described by Kurt Kaczmarek here https://www.sciencedirect.com/science/article/pii/S1026309811001702
//than can be changed to create a large range of sensations on the tongue.
int  PP[] = {50,50,50,50,50,50,50,50,50,50,50,50,50,50,50,50,50,50};
int  Pp[] = {9,9,9,9,9,9,9,9,9,9,9,9,9,9,9,9,9,9};
int  IN[] = {3,3,3,3,3,3,3,3,3,3,3,3,3,3,3,3,3,3};
int  IP[] = {150,150,150,150,150,150,150,150,150,150,150,150,150,150,150,150,150,150};
int  ON[] = {5,5,5,5,5,5,5,5,5,5,5,5,5,5,5,5,5,5};

   int i = 0;
   int temp = 0;
   
Cthulhu mycthulhu; //creating and instance of Cthulhu

void updatearray()
{


for(int i = 0;i<16;i++)
{
  if(mypixelTable[i] > 0 && mypixelTable[i]<255)
  {
    array[i+2]=1;
    Pp[i+2] = mypixelTable[i]*15;   
  }
  else{
    array[i+2]=0;
  }
}
mycthulhu.UpdateStimuli(array, PP, Pp, IN, IP, ON);

}

void setup() {

  // Start your preferred I2C object 
  Wire.begin();
  // Library assumes "Wire" for I2C but you can pass something else with begin() if you like
  grideye.begin();
  // Pour a bowl of serial
  Serial.begin(115200);
    mycthulhu.Begin();

}

void loop() {

  // Print the temperature value of each pixel in floating point degrees Celsius
  // separated by commas 
  for(unsigned char i = 0; i < 64; i++){
    temp = grideye.getPixelTemperature(i);
    pixelTable[i] = map(temp, COLD, HOT, 0, 3);

    Serial.print(temp);
    Serial.print(",");
  } 

  // End each frame with a linefeed
  Serial.println();

  // Give Processing time to chew
  //delay(100);
        maximum();
      updatearray();
      mycthulhu.Stimulate();
      mycthulhu.Stimulate();
      mycthulhu.Stimulate();
      //i = 0;

}

void maximum()
{
  for (int i = 0;i<4;i++)
  {
    mypixelTable[i] = max(max(pixelTable[0+(2*i)] , pixelTable[1+(2*i)]) , max(pixelTable[8+(2*i)] , pixelTable[9+(2*i)])) ;
  }
    for (int i = 0;i<4;i++)
  {
    mypixelTable[i+4] = max(max(pixelTable[16+(2*i)] , pixelTable[17+(2*i)]) , max(pixelTable[24+(2*i)] , pixelTable[25+(2*i)])) ;
  }
    for (int i = 0;i<4;i++)
  {
    mypixelTable[i+8] = max(max(pixelTable[32+(2*i)] , pixelTable[33+(2*i)]) , max(pixelTable[40+(2*i)] , pixelTable[41+(2*i)])) ;
  }
    for (int i = 0;i<4;i++)
  {
    mypixelTable[i+12] = max(max(pixelTable[48+(2*i)] , pixelTable[49+(2*i)]) , max(pixelTable[56+(2*i)] , pixelTable[57+(2*i)])) ;
  }
  
}
